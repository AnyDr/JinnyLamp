## main/Kconfig.projbuild
```kconfig
menu "Jinny Wireless"

config J_WIFI_SSID
    string "WiFi SSID"
    default ""

config J_WIFI_PASS
    string "WiFi Password"
    default ""

config J_WIFI_FALLBACK_CH
    int "Fallback WiFi/ESPNOW channel (used when SSID is empty or not connected)"
    range 1 13
    default 1

config J_NODE_ID
    int "Node ID (for ESPNOW addressing)"
    range 1 65535
    default 1

config J_ESPNOW_PEER_MAC
    string "ESPNOW peer MAC (aa:bb:cc:dd:ee:ff). Empty disables peer add."
    default ""

endmenu

menu "Jinny DOA"

config J_DOA_DEBUG
    bool "Enable DOA debug (adds DOA DEBUG effect + enables DOA logs)"
    default n
    help
        When enabled, lamp exposes extra FX "DOA DEBUG" (remote will see it),
        and DOA debug logging is compiled in. Single switch for both.

endmenu
```
